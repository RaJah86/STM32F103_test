/////////////////////////////////////////////////////////////////////////
//
//										 I2C.C
//										(I2C.h)
//		Настройка I2C МК. 
//		Для МК: STM32F103
//
//		Foton6
//		11.04.2017
//
//
/////////////////////////////////////////////////////////////////////////



#include "I2C.h"


I2CStruct	*I2C2_Struct;


///////////////////////___Инициализация I2C___/////////////////////////
//
//	Настраивает модуль I2C в необходимый режим.
//
///////////////////////////////////////////////////////////////////////

void I2C_HeaderInit (void)
{	
//	RCC->APB1ENR |= RCC_APB1ENR_I2C1EN;		//__Включить тактирование I2C1.
	RCC->APB1ENR |= RCC_APB1ENR_I2C2EN;		//__Включить тактирование I2C2.

	
		////___Настройка пинов___////

	RCC->APB2ENR |= RCC_APB2ENR_IOPBEN;	//__Включить тактироване порта B.

	GPIOB->CRH |= GPIO_CRH_CNF10;		//__B10 открытый сток, альтернативная функция.
	GPIOB->CRH |= GPIO_CRH_CNF11;		//__B11 открытый сток, альтернативная функция.
	
	GPIOB->CRH |= GPIO_CRH_MODE10;		//__B10 режим HighSpeed.
	GPIOB->CRH |= GPIO_CRH_MODE11;		//__B11 режим HighSpeed.	
	
		////___Настройка I2C модуля___////
		
	I2C2->CR2 = ((~I2C_CR2_FREQ & I2C2->CR2) | 36);		//__Частота шины APB1 - 36МГц.	
	//I2C2->CCR = 0x8000;	//	~I2C_CCR_FS;		//__SM мод.
	//	I2C2->CCR |= I2C_CCR_DUTY;			//__Режим 16:9.
	I2C2->CCR = ((I2C2->CCR & ~I2C_CCR_CCR) | 100);		//__Настройка частоты.
		
	I2C2->TRISE = 0x04;	
	

}

///////////////////___Разрешение прерываний событий I2C___/////////////////////
//
//	Разрешает прерывания по событиям I2C.
//
//////////////////////////////////////////////////////////////////////////////

void I2C_IntEvEn (void)
{	
//	NVIC_EnableIRQ(I2C1_EV_IRQn);
//	I2C1->CR2 |= I2C_CR2_ITEVTEN ;
	
	NVIC_EnableIRQ(I2C2_EV_IRQn);
	I2C2->CR2 |= I2C_CR2_ITEVTEN ;
}

/////////////////////////////////////////////////////////////////////////////////////



//////////////////////////___Обработчик прерываний особытий I2C2___/////////////////////////////

void I2C2_EV_IRQHandler (void)
{
	if(d_StartEnd)
	{
		d_I2C_Byte(I2C2_Struct->AdrSlave);		//__Адрес.
	}
	else if(d_AdrSendEnd)
	{
			d_I2C_SR2_Clear();
			d_I2C_Byte(0x40);						//__Данные.
			I2C2_Struct->ByteNum = 0;		
	}
	else if(d_ByteSendEnd)
	{
		if(I2C2_Struct->ByteNum < I2C2_Struct->DataLen)
		{
			d_I2C_Byte(*(I2C2_Struct->AdrData + I2C2_Struct->ByteNum));
			I2C2_Struct->ByteNum ++;
		}
		else
		{
			d_I2C_Stop();	//__Стоп.
		}
	}	
}



//////////////////////////___Обработчик прерываний ошибок I2C2___/////////////////////////////

void I2C2_ER_IRQHandler(void)
{
	while(1)
	{
	}
}





